## kernel/linux/arch/mips/brcm-boards/bcm963xx/Kconfig
```kconfig
# Kernel and Driver configuration for Broadcom Commengine ADSL board
choice
	prompt "Broadcom Commengine ADSL board"
	depends on MIPS_BRCM
	default BCM96348
	help
	  Select different Broadcom ADSL board

config BCM96338
	bool "96338 ADSL board"
	select DMA_NONCOHERENT

config BCM96348
	bool "96348 ADSL board"
	select DMA_NONCOHERENT

config BCM96358
	bool "96358 ADSL board"
	select DMA_NONCOHERENT

config BCM96368
	bool "96368 ADSL board"
	select DMA_NONCOHERENT

endchoice

config BCM_BOARD
	bool "Support for Broadcom Board"
	depends on BCM96338 || BCM96348 || BCM96358 || BCM96368

config BCM_SERIAL
	tristate "Support for Serial Port"
	depends on BCM96338 || BCM96348 || BCM96358 || BCM96368

config BCM_ENET
	tristate "Support for Ethernet"
	depends on BCM96338 || BCM96348 || BCM96358 || BCM96368

config BCM_USB
	tristate "Support for USB"
	depends on BCM96338 || BCM96348 || BCM96358 || BCM96368

config BCM_WLAN
	tristate "Support for Wireless"
	depends on BCM96338 || BCM96348 || BCM96358 || BCM96368

config BCM_PCI
	bool "Support for PCI"
	depends on BCM96338 || BCM96348 || BCM96358 || BCM96368
	select PCI

config BCM_ATMAPI
	tristate "Support for ATM"
	depends on BCM96338 || BCM96348 || BCM96358 || BCM96368

config BCM_XTMCFG
	tristate "Support for XTM"
	depends on BCM96338 || BCM96348 || BCM96358 || BCM96368

config BCM_ATMTEST
	tristate "Support for ATM Diagnostic"
	depends on BCM96338 || BCM96348 || BCM96358 || BCM96368

config BCM_ATM_BONDING
	tristate "Support for ATM BONDING"
	depends on BCM96358

config BCM_ATM_BONDING_ETH
	tristate "Support for ATM BONDING ETH"
	depends on BCM96358

config BCM_ADSL
	tristate "Support for ADSL"
	depends on BCM96338 || BCM96348 || BCM96358 || BCM96368

config BCM_ENDPOINT
	tristate "Support for VOICE"
	depends on BCM96338 || BCM96348 || BCM96358 || BCM96368

config BCM_BCMPROF
	tristate "Support for profiling"
	depends on BCM96338 || BCM96348 || BCM96358 || BCM96368

config BCM_BCMDSP
	tristate "Support for DSP application"
	depends on BCM96338 || BCM96348 || BCM96358 || BCM96368

config BCM_PROCFS
	tristate "Support for PROCFS"
	depends on BCM96338 || BCM96348 || BCM96358 || BCM96368

config BCM_VDSL
	tristate "Support for VDSL"
	depends on BCM96338 || BCM96348 || BCM96358 || BCM96368

config BCM_SECURITY
	tristate "Support for SECURITY"
	depends on BCM96338 || BCM96348 || BCM96358 || BCM96368

config BCM_HPNA
	tristate "Support for HPNA"
	depends on BCM96338 || BCM96348 || BCM96358 || BCM96368

config BCM_P8021AG
	tristate "Support for IEEE P8021.ag"
	depends on BCM96338 || BCM96348 || BCM96358 || BCM96368

config BCM_BOARD_IMPL
	int "Implementation index for ADSL Board"
	depends on BCM96338 || BCM96348 || BCM96358 || BCM96368

config BCM_SERIAL_IMPL
	int "Implementation index for Serial"
	depends on BCM96338 || BCM96348 || BCM96358 || BCM96368

config BCM_ENET_IMPL
	int "Implementation index for Ethernet"
	depends on BCM96338 || BCM96348 || BCM96358 || BCM96368

config BCM_USB_IMPL
	int "Implementation index for USB"
	depends on BCM96338 || BCM96348 || BCM96358 || BCM96368

config BCM_WLAN_IMPL
	int "Implementation index for WIRELESS"
	depends on BCM96338 || BCM96348 || BCM96358 || BCM96368

config BCM_ATMAPI_IMPL
	int "Implementation index for ATM"
	depends on BCM96338 || BCM96348 || BCM96358 || BCM96368

config BCM_XTMCFG_IMPL
	int "Implementation index for XTMCFG"
	depends on BCM96338 || BCM96348 || BCM96358 || BCM96368

config BCM_XTMRT_IMPL
  	int "Implementation index for XTMRT"
  	depends on BCM96368

config BCM_ATMTEST_IMPL
	int "Implementation index for ATM Diagnostic"
	depends on BCM96338 || BCM96348 || BCM96358 || BCM96368

config BCM_BLAA_IMPL
	int "Implementation index for BLAA"
	depends on BCM96338 || BCM96348 || BCM96358 || BCM96368

config BCM_ATM_BONDING_IMPL
	int "Implementation index for ATM BONDING"
	depends on BCM96358

config BCM_ATM_BONDING_ETH_IMPL
	int "Implementation index for ATM BONDING ETH"
	depends on BCM96358

config BCM_ADSL_IMPL
	int "Implementation index for ADSL"
	depends on BCM96338 || BCM96348 || BCM96358 || BCM96368

config BCM_ENDPOINT_IMPL
	int "Implementation index for VOICE"
	depends on BCM96338 || BCM96348 || BCM96358 || BCM96368

config BCM_BCMPROF_IMPL
	int "Implementation index for DSP APPLICATION"
	depends on BCM96338 || BCM96348 || BCM96358 || BCM96368

config BCM_BCMDSP_IMPL
	int "Implementation index for PROFILING"
	depends on BCM96338 || BCM96348 || BCM96358 || BCM96368

config BCM_PROCFS_IMPL
	int "Implementation index for PROCFS"
	depends on BCM96338 || BCM96348 || BCM96358 || BCM96368

config BCM_SECURITY_IMPL
	int "Implementation index for SECURITY"
	depends on BCM96338 || BCM96348 || BCM96358 || BCM96368

config BCM_HPNA_IMPL
	int "Implementation index for HPNA"
	depends on BCM96338 || BCM96348 || BCM96358 || BCM96368

config BCM_P8021AG_IMPL
	int "Implementation index for IEEE P8021AG"
	depends on BCM96338 || BCM96348 || BCM96358 || BCM96368

choice
	prompt "Root File System"
	depends on MIPS_BRCM
	default ROOTFS_SQUASHFS
	help
	  Select root file system on the board flash. 

config ROOTFS_SQUASHFS
        bool "SQUASHFS"
config ROOTFS_CRAMFS
        bool "CRAMFS"
config ROOTFS_JFFS2
        bool "JFFS2"
config ROOTFS_NFS
        bool "NFS"

endchoice

config ROOT_FLASHFS
	string "flash partition"
	depends on ROOTFS_SQUASHFS || ROOTFS_CRAMFS || ROOTFS_JFFS2
	default "root=31:0 ro noinitrd" if ROOTFS_SQUASHFS = y || ROOTFS_CRAMFS = y
	default "root=31:2 ro noinitrd" if ROOTFS_JFFS2 = y
	help
	  This is the root file system partition on flash memory

config ROOT_NFS_DIR
	string "NFS server path"
	depends on ROOTFS_NFS
	default "/opt/bcm96338/targets/96338R/fs" if BCM96338 = y
	default "/opt/bcm96348/targets/96348R/fs" if BCM96348 = y  
	default "/opt/bcm96358/targets/96358R/fs" if BCM96358 = y  
	default "/opt/bcm96368/targets/96368R/fs" if BCM96368 = y  
	help
	  This is the path of NFS server (host system)
```
